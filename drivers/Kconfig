## drivers/Kconfig
```kconfig
config RT_USING_UART0
    bool "Enable UART0 (The UART component name is UART0 in the TopDesign of PSoC Creator)"
    default y

config CY8C624AAZI_D44
    bool
    select RT_USING_COMPONENTS_INIT
    select RT_USING_USER_MAIN
    default y
	
config BSP_USING_LCD
	bool "Enable LCD"
	default y
```
